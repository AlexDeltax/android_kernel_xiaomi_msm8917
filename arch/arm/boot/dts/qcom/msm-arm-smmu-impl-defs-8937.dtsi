/*
 * Copyright (c) 2015, The Linux Foundation. All rights reserved.
 *
 * This program is free software; you can redistribute it and/or modify
 * it under the terms of the GNU General Public License version 2 and
 * only version 2 as published by the Free Software Foundation.
 *
 * This program is distributed in the hope that it will be useful,
 * but WITHOUT ANY WARRANTY; without even the implied warranty of
 * MERCHANTABILITY or FITNESS FOR A PARTICULAR PURPOSE.  See the
 * GNU General Public License for more details.
 */

&kgsl_smmu {
	attach-impl-defs = <0x6000 0x270>,
		<0x6060 0x1055>,
		<0x6800 0x6>,
		<0x6900 0x3ff>,
		<0x6924 0x204>,
		<0x6928 0x10800>,
		<0x6930 0x400>,
		<0x6960 0xffffffff>,
		<0x6b64 0xa0000>,
		<0x6b68 0xaaab92a>;
};

&spi_6 {
    status = "ok";
    peel_ir@0 {
        compatible = "peel_ir";
        reg = <0x0>;
        spi-max-frequency = <19200000>;
        vdd-supply = <&pm8953_l8>; //vdd
        peel_ir,reg-id = "vdd";
        peel_ir,lr-gpio = <73>;
        peel_ir,lr-gpio-valid = <0>;
        peel_ir,spi-bpw = <32>;
        peel_ir,spi-clk-speed = <960000>;
        peel_ir,spi-mode = <0>;
        peel_ir,peel-field = <2345>;
        status = "ok";
    };
};